## CMakeLists.txt
```
# SPDX-License-Identifier: Apache-2.0

cmake_minimum_required(VERSION 3.20.0)

find_package(Zephyr REQUIRED HINTS $ENV{ZEPHYR_BASE})
project(hello_world)

FILE(GLOB app_sources src/*.c)
target_sources(app PRIVATE ${app_sources}
src/Data_processing/data_processor.c;
src/Handlers/initiater.c;
src/Handlers/observer.c;
src/Search_algorithms/search.c;
src/Servo/encoder.c;
src/Servo/servo.c;
src/Handlers/buttons.c;
src/Misc/laser.c
)

zephyr_library_include_directories(
    ${ZEPHYR_BASE}/samples/bluetooth
    src/Data_processing;
    src/Handlers;
    src/Search_algorithms;
    src/Servo;
    src/Misc)
```

## prj.conf
```kconfig
# Configure logger
CONFIG_LOG=y
CONFIG_USE_SEGGER_RTT=n
CONFIG_LOG_BACKEND_UART=y
CONFIG_LOG_DEFAULT_LEVEL=3


#From observer
CONFIG_BT=y
CONFIG_BT_OBSERVER=y

# Configure buttons and LEDs
CONFIG_GPIO=y
CONFIG_DK_LIBRARY=y

# Enable the BLE modules from NCS
CONFIG_BT_NUS_CLIENT=y
CONFIG_BT_CENTRAL=y
CONFIG_BT_SCAN=y
CONFIG_BT_SCAN_FILTER_ENABLE=y
CONFIG_BT_SCAN_UUID_CNT=1
CONFIG_BT_GATT_DM=y
CONFIG_HEAP_MEM_POOL_SIZE=2048
CONFIG_BT_FILTER_ACCEPT_LIST=y
CONFIG_BT_SCAN_NAME_CNT=1


# Enable math.h
CONFIG_NEWLIB_LIBC=y

#vet ikke
CONFIG_MAIN_STACK_SIZE=1024
CONFIG_SYSTEM_WORKQUEUE_STACK_SIZE=4096
CONFIG_USERSPACE=y
CONFIG_MULTITHREADING=y
CONFIG_NRFX_QDEC=y
```

## src/main.c
```c
#include "initiater.h"
#include "nrfx_qdec.h"
#include <stdio.h>

K_SEM_DEFINE(my_sem,0,1);

zeros zero_enc_values;


void main(void)
{
	printk("Hello Nordic Semiconductor!\n");
	int err = initiate_modules();
	if(err){
		printk("Error while initiating modules (error: %d). \n", err);
		exit();
	}
	k_sem_take(&my_sem, K_FOREVER);
	k_msleep(2000);
	

	zero_enc_values = coarse_search();
	printk("azimuth zero enc: %d, horizontal zero end: %d\n", zero_enc_values.azimuth, zero_enc_values.elevation);
	zero_enc_values = fine_search(zero_enc_values);
	printk("Search is done\n");
	printk("Zeroes found at Azimuth: %d, Elevation: %d\n", zero_enc_values.azimuth, zero_enc_values.elevation);
	angle_move_servo(0,zero_enc_values.azimuth);
	angle_move_servo(1, zero_enc_values.elevation);
	laser_set(0);

	while(1){
		k_sleep(K_FOREVER);
	}
}
```

## src/data_processor.h
```c
#include "encoder.h"
#include <zephyr/types.h>

/**
 * @brief Minimum value for RSSI
 * Minimum valid value for RSSI measurement, if values goes under this it becomes
 * invalid and the measurement will not be used
 */
#define MIN_VALID_RSSI -90
/**
 * @brief Maximum value for RSSI
 * Maximum valid value for RSSI measurement, if values goes over this it becomes
 * invalid and the measurement will not be used 
 */
#define MAX_VALID_RSSI -25
/**
 * @brief Values measured at one point.
 * This struct is used to store the measured values for encoder,
 * RSSI at delta (phaseshifted) and RSSI for zigma(phase) at each measuring point.
 * 
 */
typedef struct data_s
{
    int16_t encoder;
    int16_t delta;
	int16_t zigma;
} matrix_x3;

/**
 * @brief Encoder values for zero-points
 * This struct stores the encoder values for the zero-points.
 * 
 */
typedef struct data_a
{
    int16_t azimuth;
    int16_t elevation;
} zeros;

/**
 * @brief Sends measured RSSI signal into array
 * This function is used by "Observer.c" to send measured RSSI value
 * to either array for delta measurements or zigma measurements (data_delta and data_zigma).
 * The array is later used by "get_average" calculate the average value for a more specific reading.
 * 
 * @param rssi Value thats gone through Kalman filter
 * @param index Index for where to store in the array
 * @param state 0 for delta and 1 for zigma
 */
void send_data(int16_t rssi, int index, int state);

/**
 * @brief Set the average counter object
 * This function is used to set how many RSSI values should be measured before calculating
 * the average RSSI value. If counter has a higher cap on 10 and lower cap on 1.
 * @param value Counter value
 */
void set_average_counter(int16_t value);

/**
 * @brief Get the average object
 * This function is used to get the average RSSI value from array of RSSI values.
 * @param list List of RSSI values
 * @return Average value from list input 
 */
int16_t get_average(int16_t list[]);

/**
 * @brief Get the data object
 * This function takes in a "matrix_x3" and transfers the current stored Delta, Zigma and
 * encoder value into the variable.
 * @param buffer_data A pointer to a "matrix_x3" variable
 * @param N 0 for Azimuth and 1 for Elevation
 */
void get_data(matrix_x3 *buffer_data, int N);

/**
 * @brief Validates the measured values
 * This function checks the array consist of measured values are either over maximum set value
 * "MAX_VALID_RSSI" or under "MIN_VALID RSSI". If the values are outside the allowed are
 * the array at the index is set to 0.
 * @param raw_data A pointer to array with measured values
 * @param n A pointer to size of the array
 */
void value_validater(matrix_x3 *raw_data, int16_t *n);

/**
 * @brief Updates array
 * This function checks if some of the indexes of the array is set to 0. It will then
 * delete that index and update the size of the variable n.
 * 
 * @param data A pointer to array with measured values
 * @param n A pointer to size of the array
 */
void update_matrix(matrix_x3 *data, int16_t *n);

/**
 * @brief Checks if the measured point is an valid null-point
 * This function checks if the Delta value is smaller than the Zigma value and if the
 * Zigma value is smaller than the "ZIGMA_ZERO_VALUE". Returns true if the conditions 
 * are met and false else.
 * 
 * @param value_zigma Zigma RSSI value
 * @param value_delta Delta RSSI value
 * @param ZIGMA_ZERO_VALUE 
 * @return true If the condition are met
 * @return false If the conditions ar enot met
 */
bool zero_point_validater(int16_t value_zigma, int16_t value_delta, int16_t ZIGMA_ZERO_VALUE);

/**
 * @brief Finds the encoder zero point value of search
 * This function starts with calling "find_zigma_zero_value". Next it will find the first valid zero-point
 * and go through the rest of the array to find and return the lowest valid zero-point.
 * @param validated_values Array of measured values
 * @param n Size of array
 * @return index of zero-point
 */
int find_zero_point(matrix_x3 validated_values[], int n);

/**
 * @brief Finds new ZIGMA_ZERO_VALUE
 * This function takes in a array of measured values and finds the highest value for Zigma that are
 * used to verify the zero-point. It will subtract the highest value by 3 and return this value
 * @param values Array of measured values
 * @param n Size of array
 * @return int16_t Modified ZIGMA_ZERO_VALUE
 */
int16_t find_zigma_zero_value(matrix_x3 values[], int n);
```

## src/initiater.h
```c
// #include "button_leds.h"
#include "buttons.h"
/**
 * @brief Initiate necessary modules
 * This function initiates buttons, leds, timer, BLE, servomotors, laser and azimuth encoder.
 * Sets the average_counter to 1 and turns of the laser. If an error occurs while initiating a module
 * it will print and return the error code and exit the function.
 * 
 * @return int 0 when successful
 */

int initiate_modules();
```

## src/kalman_filter.h
```c
#include <zephyr/types.h>


/**
 * @brief Function for filtering the measured RSSI value.
 * 
 * This function takes in the measured RSSI value and will update the Kalman Gain
 * and the estimated RSSI value based on the static constant values set in the function.
 * It will then update the error covarianse which is used when calculating the estimated RSSI value.
 * The function will return the raw RSSI value for the first RSSI value measured.
 * 
 * 
 * @param U The raw RSSI value sent in the function
 * @return  The estimated RSSI value calculated
 */
int8_t KALMAN_DELTA(int8_t U);

/**
 * @brief Function for filtering the measured RSSI value.
 * 
 * This function takes in the measured RSSI value and will update the Kalman Gain
 * and the estimated RSSI value based on the static constant values set in the function.
 * It will then update the error covarianse which is used when calculating the estimated RSSI value.
 * The function will return the raw RSSI value for the first RSSI value measured.
 * 
 * 
 * @param U The raw RSSI value sent in the function
 * @return  The estimated RSSI value calculated
 */
int8_t KALMAN_ZIGMA(int8_t U);
```

## src/laser.h
```c
#include <zephyr.h>
#include <sys/printk.h>
#include <device.h>
#include <devicetree.h>
#include <drivers/gpio.h>

/**
 * @brief Initialize laser pointer
 * 
 * @param laser_pin Pin connected to laser +5v (nRF52 not compatible with 5v on gpio).
 */
int laser_init();

/**
 * @brief Toggles laser pointer on or off
 * 
 */
void laser_toggle(void);

/**
 * @brief Set laser to state.
 * 
 * @param state int, 0 for on, 1 for off.
 */
void laser_set(int state);
```

## src/observer.h
```c
#include <bluetooth/bluetooth.h>
#include "data_processor.h"



/**
 * @brief Adds address to filter
 * This function takes in an address and adress type in form of a string and 
 * converts this into an ble_address. The address is then added into the filter
 * accept list. 
 * 
 * @param addr_str Address in form of a string
 * @param type Type in form of a string ("random") or ("public")
 * @return int 0 if successful
 */

int add_filter_accept_list_from_string(const char *addr_str,const char *type);

/**
 * @brief Initiates bluethooth
 * This function starts by defining the parameters for the observer handler,
 * setting the device tree to "GPIO_0", further the function enables bluethooth,
 * adds address to filter list, initiates and starts the Observer handler and initiate the
 * GPIO used for the switch
 * 
 * @return int 0 if successful
 */
int init_bluethooth_scan();

/**
 * @brief Observer handler
 * The static variable counter and state (0 for Delta, 1 for Zigma) are defined.
 * When send_data_state is true this handler alternates sending the filtrated RSSI value to 
 * array for Delta and Zigma values depending on the value of "average_counter". When alternating
 * it sets the GPIO for the switch "0" for measuring in Zigma and "1" for measuring in Delta.
 * When the function has goes from Zigma measuring to Delta measuring it will free the semaphore "my_sem",
 * which is used to ensure that the observer has gotten both measurement in Delta and Zigma before the robot moves.
 * If the variable send_data_state is false the handler will not do anything when entering.
 * @param addr Adress of the observed signal
 * @param rssi RSSI value of the observed signal
 * @param type Address type of the observed signal
 * @param ad Add of the observed signal
 */
static void device_found(const bt_addr_le_t *addr, int8_t rssi, uint8_t type, struct net_buf_simple *ad);

/**
 * @brief Set the observer object
 * This function is being used by "sweep_search" to activate the logic inside the observer handler
 * @param state false or true
 */
void set_observer(bool state);
```

## src/search.h
```c
#include "observer.h"

#define MOTOR_TEST 0

/**
 * @brief Activates search in azimuth
 * 0 to deactivate search in azimuth, 1 to activate search in azimuth
 * 
 */
#define SEARCH_AZIMUTH 1
/*0
 * @brief Activates serach in elevation
 * 0 to deactivate search in elevation, 1 to activate search in elevation
 */
#define SEARCH_ELEVATION 1
/**
 * @brief Activates fine search
 * 0 to deactivate fine search, 1 to activate fine search
 */
#define FINE_ACTIVATE 1


/**
 * @brief Search and stores RSSI values within given area
 * This function changes the value for servo angle variable that the Threads
 * use to move the servo. Further the function activates the logic in the 
 * observer handler and waits until the semaphore is released from the handler
 * before it gets and transfer the data to readings array. It does this for the
 * whole sweep sector before releasing the semaphore.
 * 
 * @param state 0 for azimuth, 1 for Elevation
 * @param min_encoder_search Minimum search degrees for search sector
 * @param max_encoder_search Maximum search degrees for search sector
 * @param increment Value for increment for degrees
 */
void sweep_search(int state, int16_t min_encoder_search, int16_t max_encoder_search, int increment);

/**
 * @brief Get the readings object
 * This function is used to validate, update and retrieve the readings that were
 * done by sweep_search before resetting the array "readings"
 * @param main_readings Pointer to where the array where values are being stored
 * @param n Pointer to size of array
 * @return int 0 when successfull
 */
int get_readings(matrix_x3 *main_readings, int16_t *n);

/**
 * @brief Fine search of RSSI values
 * This function starts by calculating the new min_encoder_value and max_encoder_value
 * based on the zero_point and the sweep_sector. Further the function sets the 
 * average counter to 10 to get more accurate readings.
 * Then it calls on "sweep_search" with the new calculated parameters, gets the 
 * measurements and finds the zero-point index. 
 * The readings are then analysed for finding a new sweeps ector based on the delta value
 * at the zero-point index and threashold_degrees.
 * Depending if the new sweep sector is under threshold_search the function either exits
 * or calls upon itself (recursion) with the new parameters calculated
 * 
 * 
 * @param state 0 for Delta 1 for Zigma
 * @param threshold_degrees Threshold for RSSI value when defining new sweep sector
 * @param threshold_search Threshold for exiting function
 * @param sweep_sector Value for sweep sector
 * @param zero_point Encoder value for zero-point
 * @return int16_t Encoder value for zero-point
 */
int16_t fine_sweeper(int state, int threshold_degrees, int threshold_search, int sweep_sector, int16_t zero_point);

/**
 * @brief Sets values to 0
 * This function set all the values of the array "readings" to 0
 * @return zeros 0 when successful
 */
void reset_readings();


/**
 * @brief Coarse search
 * * This function starts search in azimuth plane by calling upon the "sweep_search" and uses
 * "find_zero_point" to find the encoder value for the zero-point. After finding the zero-point
 * it uses "validate_servo_zero_moved" to validate that the servomotor is at zero-point.
 * If SEARCH_PLANE is defined to be higher than 1 it starts by turning the antenna 90 degrees and 
 * searches in the elevation plane. 
 * When switching search plane the thread and encoder that is not being searched are disabled.
 * 
 * 
 * @return zeros Encoder values for zero-point in azimuth and elevation
 */
zeros coarse_search();

/**
 * @brief Fine search
 * This function starts by calling upon "fine_sweeper" with the parameters given and finds the
 * encoder values for the zero-point before it validates that the servo is at zero-point. 
 * If SEARCH_PLANE is defined to be higher than 1 it starts by turning the antenna 90 degrees and 
 * searches in the elevation plane.
 * When switching search plane the thread and encoder that is not being searched are disabled.
 * @param enc_values Zero-point values for azimuth and elevation plane
 * @return zeros Encoder values for zero-point in azimuth and elevation
 */
zeros fine_search(zeros enc_values);

/**
 * @brief Validates servomotor position
 * This function checks if the servomotor is at angle given from parameters.
 * It is used to wait for the motor is at correct position before the code starts searching in 
 * another plane.
 * 
 * @param N 0 for azimuth servomotor, 1 for elevation servomotor
 * @param zero_point_servo_angle Value for servomotor angle
 */
void validate_servo_zero_moved(int N, uint32_t zero_point_servo_angle);

/**
 * @brief Moves azimuth servo
 * Thread that is used to move servomotor for azimuth plane
 * 
 * @param azimuth_thread_servo_angle 
 */
void azimuth_servo_thread(uint32_t *azimuth_thread_servo_angle);

/**
 * @brief Moves elevation servo
 * Thread that is used to move servomotor for elevation plane
 * 
 * @param elevation_thread_servo_angle 
 */
void elevation_servo_thread(uint32_t *elevation_thread_servo_angle);
```

## src/servo.h
```c
#include <zephyr.h>
#include <logging/log.h>
#include <drivers/gpio.h>
/**
 * @brief Init timer
 * 
 */
int timer_init();

/**
 * @brief Start timer
 * 
 */
int timer_start();

/**
*@brief Funciton that initializes servo on specified pin. IMPORTANT, for servos to behave correctly,
* all prior servos N have to be initialized, and in order. That is, if initializing servo N = 1, 
* servo N = 0 has to also be initialized first.
*
* Takes in two parameters
* @param N Servo numer, from 0 to 3
* @param servo_pin Pin where servo is connected
*/
int servo_init(uint32_t N, int servo_pin);

/**
 * @brief Move servo to angle given in degrees
 * 
 * @param N Servo to be moved
 * @param angle Angle given in degrees
 */
void angle_move_servo(int N, uint32_t angle);

/**
 * @brief Move servo to position in ticks
 * 
 * Raw position is given in ticks, in this case the timer is running at a 
 * frequency of 16MHz. We have a counter modulus, TIMER_RELOAD of 320000. This
 * was found by dividing clock speed with servo frequency.
 * If our servo needs input frequency of 50Hz, we divide 50^-1 by 320000 and
 * get the period counter. If we know the dudy cycle of the servo, we can
 * calculate the input needed to position the servo with:
 *      W = duty_cycle/period_counter
 * For example, with neutral position in 1.5ms, we have:
 *      W = 0.0015/6.25*10^-8 = 24000
 * 
 * Specs for MG90S, 0.5ms to 2.5ms, neutral at 1.5, 0deg to 180deg
 * Specs for SER0038, 0.5ms = 0deg, 2.5ms = 270deg, 1.5 neutral
 * 
 * @param N Servo to be moved
 * @param position Position in ticks
 */
void raw_move_servo(int N, uint32_t position);


uint32_t sin_scaled(uint32_t input, uint32_t input_max, uint32_t output_min, uint32_t output_max);

/**
 * @brief Increments servo angle
 * Depending on the parameter N the function will update the servomotor angle and
 * use the function "raw_move_servo" and "convert_to_raw" to increment the servomotor angle
 * @param N 0 for azimuth, 1 for elevation
 */
void increment_servo(int N);

/**
 * @brief 
 * Depending on the parameter N the function will update the servomotor angle and
 * use the function "raw_move_servo" and "convert_to_raw" to decrement the servomotor angle
 * @param N 0 for azimuth, 1 for elevation
 */
void decrement_servo(int N);

/**
 * @brief Get the servo angle object
 * Depending on the parameter N the function will return either the servomotor angle
 * for either azimuth or elevation
 * @param N 0 for azimuth, 1 for elevation
 * @return int16_t Servomotor angle
 */
int16_t get_servo_angle(int N);
```
