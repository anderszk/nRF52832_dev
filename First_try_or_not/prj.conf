## prj.conf
```kconfig
# Configure logger
CONFIG_LOG=y
CONFIG_USE_SEGGER_RTT=n
CONFIG_LOG_BACKEND_UART=y
CONFIG_LOG_DEFAULT_LEVEL=3

#From observer
CONFIG_BT=y
CONFIG_BT_OBSERVER=y

# Configure buttons and LEDs
CONFIG_GPIO=y
CONFIG_DK_LIBRARY=y
```

## src/main.c
```c
/*
 * Copyright (c) 2012-2014 Wind River Systems, Inc.
 *
 * SPDX-License-Identifier: Apache-2.0
 */

#include <zephyr.h>
#include <logging/log.h>
#include <dk_buttons_and_leds.h>
#include <sys/printk.h>
#include "observer.h"
#include "button_leds.h"




void main(void)
{
	
	
	timer_init();
	timer_start();
	configure_dk_buttons_leds();
	init_bluethooth_scan();

	for(;;){


	}


}
```
